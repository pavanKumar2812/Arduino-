#include <ESP8266WiFi.h>
#include <pgmspace.h>

WiFiClient client;
WiFiServer server(80);

const int ledPin = 2; // GPIO pin where the LED is connected
const int dt = 200;

const char index_html[] PROGMEM = {
  0x1f, 0x8b, 0x08, 0x08, 0xcc, 0x2f, 0x1d, 0x65, 0x04, 0x00, 0x69, 0x6e,
  0x64, 0x65, 0x78, 0x2e, 0x68, 0x74, 0x6d, 0x6c, 0x00, 0x6d, 0x90, 0xb1,
  0x6e, 0x03, 0x21, 0x0c, 0x86, 0xf7, 0x4a, 0x7d, 0x07, 0x97, 0xb9, 0x57,
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  0x4f, 0x01, 0x00, 0x00
};

const char* ssid = "IDR@MakersLab";
const char* password = "12345678";

void setup() {
  Serial.begin(9600);
  pinMode(ledPin, OUTPUT);
  digitalWrite(ledPin, HIGH);
  WiFi.begin(ssid, password);
  while (WiFi.status() != WL_CONNECTED) 
  {
    Serial.print("..");
    delay(dt);
  }
  Serial.println("");
  Serial.println("NodeMCU is connected...!");
  Serial.println(WiFi.localIP());
  server.begin();
}

void loop() {
  client = server.available();
  if (client) 
  {
    String request = client.readStringUntil('\n');
    Serial.println(request);
    request.trim(); // removes all leading/trailing whitespaces from the string
    if (request.indexOf("GET /ledon HTTP/1.1") != -1) 
    {
      digitalWrite(ledPin, LOW);
    }
    if (request.indexOf("GET /ledoff HTTP/1.1") != -1) 
    {
      digitalWrite(ledPin, HIGH);
    }

    client.println("HTTP/1.1 200 OK");
    client.println("Content-Encoding: gzip");
    client.println("Content-Type: text/html");
    client.println();
    client.write_P(index_html, sizeof(index_html));
  }
}